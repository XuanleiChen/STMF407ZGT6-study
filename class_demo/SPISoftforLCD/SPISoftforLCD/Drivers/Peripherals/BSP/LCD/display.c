#include "display.h"

u8 Display_Direction = 0;
u16 Display_Width = 240;
u16 Display_Height = 320;

const unsigned char ascii_1206[][12]={
	{0x00,0x00,0x00,0x00,0x00,0x00,0x00,0x00,0x00,0x00,0x00,0x00},/*" ",0*/
	{0x00,0x00,0x04,0x04,0x04,0x04,0x04,0x00,0x00,0x04,0x00,0x00},/*"!",1*/
	{0x14,0x14,0x0A,0x00,0x00,0x00,0x00,0x00,0x00,0x00,0x00,0x00},/*""",2*/
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	{0x16,0x09,0x00,0x00,0x00,0x00,0x00,0x00,0x00,0x00,0x00,0x00},/*"~",94*/
};

const unsigned char ascii_1608[][16]={
	{0x00,0x00,0x00,0x00,0x00,0x00,0x00,0x00,0x00,0x00,0x00,0x00,0x00,0x00,0x00,0x00},/*" ",0*/
	{0x00,0x00,0x00,0x08,0x08,0x08,0x08,0x08,0x08,0x08,0x00,0x00,0x18,0x18,0x00,0x00},/*"!",1*/
	{0x00,0x48,0x6C,0x24,0x12,0x00,0x00,0x00,0x00,0x00,0x00,0x00,0x00,0x00,0x00,0x00},/*""",2*/
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	{0x0C,0x32,0xC2,0x00,0x00,0x00,0x00,0x00,0x00,0x00,0x00,0x00,0x00,0x00,0x00,0x00},/*"~",94*/
};
	
const unsigned char ascii_2412[][48]={
	{0x00,0x00,0x00,0x00,0x00,0x00,0x00,0x00,0x00,0x00,0x00,0x00,0x00,0x00,0x00,0x00,0x00,0x00,0x00,0x00,0x00,0x00,0x00,0x00,0x00,0x00,0x00,0x00,0x00,0x00,0x00,0x00,0x00,0x00,0x00,0x00,0x00,0x00,0x00,0x00,0x00,0x00,0x00,0x00,0x00,0x00,0x00,0x00},/*" ",0*/
	{0x00,0x00,0x00,0x00,0x00,0x00,0x00,0x00,0x60,0x00,0x60,0x00,0x60,0x00,0x60,0x00,0x60,0x00,0x60,0x00,0x60,0x00,0x40,0x00,0x20,0x00,0x20,0x00,0x20,0x00,0x00,0x00,0x00,0x00,0x00,0x00,0x60,0x00,0x60,0x00,0x60,0x00,0x00,0x00,0x00,0x00,0x00,0x00},/*"!",1*/
	{0x00,0x00,0x00,0x00,0x60,0x06,0x60,0x06,0x30,0x03,0x98,0x01,0x88,0x00,0x44,0x00,0x00,0x00,0x00,0x00,0x00,0x00,0x00,0x00,0x00,0x00,0x00,0x00,0x00,0x00,0x00,0x00,0x00,0x00,0x00,0x00,0x00,0x00,0x00,0x00,0x00,0x00,0x00,0x00,0x00,0x00,0x00,0x00},/*""",2*/
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	{0x00,0x00,0x1C,0x00,0x22,0x04,0xC2,0x04,0x80,0x03,0x00,0x00,0x00,0x00,0x00,0x00,0x00,0x00,0x00,0x00,0x00,0x00,0x00,0x00,0x00,0x00,0x00,0x00,0x00,0x00,0x00,0x00,0x00,0x00,0x00,0x00,0x00,0x00,0x00,0x00,0x00,0x00,0x00,0x00,0x00,0x00,0x00,0x00},/*"~",94*/
};
	
const unsigned char ascii_3216[][64]={
	{0x00,0x00,0x00,0x00,0x00,0x00,0x00,0x00,0x00,0x00,0x00,0x00,0x00,0x00,0x00,0x00,0x00,0x00,0x00,0x00,0x00,0x00,0x00,0x00,0x00,0x00,0x00,0x00,0x00,0x00,0x00,0x00,0x00,0x00,0x00,0x00,0x00,0x00,0x00,0x00,0x00,0x00,0x00,0x00,0x00,0x00,0x00,0x00,0x00,0x00,0x00,0x00,0x00,0x00,0x00,0x00,0x00,0x00,0x00,0x00,0x00,0x00,0x00,0x00},/*" ",0*/
	{0x00,0x00,0x00,0x00,0x00,0x00,0x00,0x00,0x00,0x00,0xC0,0x01,0xC0,0x01,0xC0,0x01,0xC0,0x01,0xC0,0x01,0xC0,0x01,0xC0,0x01,0x80,0x00,0x80,0x00,0x80,0x00,0x80,0x00,0x80,0x00,0x80,0x00,0x80,0x00,0x00,0x00,0x00,0x00,0x00,0x00,0x00,0x00,0x80,0x01,0xC0,0x03,0xC0,0x03,0x80,0x01,0x00,0x00,0x00,0x00,0x00,0x00,0x00,0x00,0x00,0x00},/*"!",1*/
	{0x00,0x00,0x00,0x00,0x00,0x00,0xE0,0x1C,0xE0,0x1C,0xF0,0x1E,0x70,0x0E,0x38,0x07,0x18,0x03,0x08,0x01,0x84,0x00,0x00,0x00,0x00,0x00,0x00,0x00,0x00,0x00,0x00,0x00,0x00,0x00,0x00,0x00,0x00,0x00,0x00,0x00,0x00,0x00,0x00,0x00,0x00,0x00,0x00,0x00,0x00,0x00,0x00,0x00,0x00,0x00,0x00,0x00,0x00,0x00,0x00,0x00,0x00,0x00,0x00,0x00},/*""",2*/
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	{0x00,0x00,0x38,0x00,0xC4,0x00,0x86,0x40,0x02,0x61,0x00,0x22,0x00,0x1C,0x00,0x00,0x00,0x00,0x00,0x00,0x00,0x00,0x00,0x00,0x00,0x00,0x00,0x00,0x00,0x00,0x00,0x00,0x00,0x00,0x00,0x00,0x00,0x00,0x00,0x00,0x00,0x00,0x00,0x00,0x00,0x00,0x00,0x00,0x00,0x00,0x00,0x00,0x00,0x00,0x00,0x00,0x00,0x00,0x00,0x00,0x00,0x00,0x00,0x00},/*"~",94*/
};

typedef struct 
{
	char Index[3];	
	char Msk[24];
}typFNT_GB12;

const typFNT_GB12 tfont12[]={
	"中",
	0x20,0x00,0x20,0x00,0x20,0x00,0xFE,0x03,0x22,0x02,0x22,0x02,0x22,0x02,0xFE,0x03,
	0x22,0x02,0x20,0x00,0x20,0x00,0x20,0x00,/*"中",0*/
	"景",
	0xFC,0x01,0x04,0x01,0xFC,0x01,0x04,0x01,0xFC,0x01,0x20,0x00,0xFF,0x07,0x04,0x01,
	0xFC,0x01,0x20,0x00,0x24,0x01,0x32,0x02,/*"景",1*/
	"园",
	0xFE,0x07,0x02,0x04,0xFA,0x04,0x02,0x04,0x02,0x04,0xFE,0x05,0x52,0x04,0x52,0x04,
	0x4A,0x05,0x86,0x05,0x02,0x04,0xFE,0x07,/*"园",2*/
	"电",
	0x10,0x00,0x10,0x00,0xFF,0x01,0x11,0x01,0x11,0x01,0xFF,0x01,0x11,0x01,0x11,0x01,
	0xFF,0x01,0x11,0x04,0x10,0x04,0xE0,0x07,/*"电",3*/
	"子",
	0x00,0x00,0xFC,0x01,0x80,0x00,0x40,0x00,0x20,0x00,0x20,0x00,0xFF,0x07,0x20,0x00,
	0x20,0x00,0x20,0x00,0x20,0x00,0x38,0x00,/*"子",4*/
};

typedef struct 
{
	char Index[3];	
	char Msk[32];
}typFNT_GB16;

const typFNT_GB16 tfont16[]={
	"中",
	0x80,0x00,0x80,0x00,0x80,0x00,0x80,0x00,0xFC,0x1F,0x84,0x10,0x84,0x10,0x84,0x10,
	0x84,0x10,0x84,0x10,0xFC,0x1F,0x84,0x10,0x80,0x00,0x80,0x00,0x80,0x00,0x80,0x00,/*"中",0*/
	"景",
	0xF8,0x0F,0x08,0x08,0xF8,0x0F,0x08,0x08,0xF8,0x0F,0x80,0x00,0xFF,0x7F,0x00,0x00,
	0xF8,0x0F,0x08,0x08,0x08,0x08,0xF8,0x0F,0x80,0x00,0x84,0x10,0xA2,0x20,0x40,0x00,/*"景",1*/
	"园",
	0x00,0x00,0xFE,0x3F,0x02,0x20,0xF2,0x27,0x02,0x20,0x02,0x20,0xFA,0x2F,0x22,0x21,
	0x22,0x21,0x22,0x21,0x12,0x29,0x12,0x29,0x0A,0x2E,0x02,0x20,0xFE,0x3F,0x02,0x20,/*"园",2*/
	"电",
	0x80,0x00,0x80,0x00,0x80,0x00,0xFC,0x1F,0x84,0x10,0x84,0x10,0x84,0x10,0xFC,0x1F,
	0x84,0x10,0x84,0x10,0x84,0x10,0xFC,0x1F,0x84,0x50,0x80,0x40,0x80,0x40,0x00,0x7F,/*"电",3*/
	"子",
	0x00,0x00,0xFE,0x1F,0x00,0x08,0x00,0x04,0x00,0x02,0x80,0x01,0x80,0x00,0xFF,0x7F,
	0x80,0x00,0x80,0x00,0x80,0x00,0x80,0x00,0x80,0x00,0x80,0x00,0xA0,0x00,0x40,0x00,/*"子",4*/
};

typedef struct 
{
	char Index[3];	
	char Msk[72];
}typFNT_GB24;

const typFNT_GB24 tfont24[]={
	"中",
	0x00,0x00,0x00,0x00,0x00,0x00,0x00,0x18,0x00,0x00,0x08,0x00,0x00,0x08,0x00,0x00,
	0x08,0x00,0x08,0x08,0x18,0xF8,0xFF,0x1F,0x18,0x08,0x18,0x18,0x08,0x18,0x18,0x08,
	0x18,0x18,0x08,0x18,0x18,0x08,0x18,0x18,0x08,0x18,0xF8,0xFF,0x1F,0x08,0x08,0x08,
	0x00,0x08,0x00,0x00,0x08,0x00,0x00,0x08,0x00,0x00,0x08,0x00,0x00,0x18,0x00,0x00,
	0x18,0x00,0x00,0x18,0x00,0x00,0x00,0x00,/*"中",0*/
	"景",
	0x00,0x00,0x00,0x00,0x00,0x00,0x40,0x00,0x06,0xC0,0xFF,0x07,0x40,0x00,0x06,0xC0,
	0xFF,0x07,0x40,0x00,0x06,0xC0,0xFF,0x07,0x40,0x08,0x02,0x00,0x30,0x00,0xFE,0xFF,
	0x3F,0x00,0x00,0x00,0xC0,0xFF,0x07,0xC0,0x00,0x02,0xC0,0x00,0x02,0xC0,0x00,0x02,
	0xC0,0xFF,0x03,0x80,0x10,0x00,0x80,0x11,0x01,0x60,0x10,0x0E,0x30,0x10,0x18,0x0C,
	0x1E,0x30,0x00,0x1C,0x00,0x00,0x00,0x00,/*"景",1*/
	"园",
	0x00,0x00,0x00,0x00,0x00,0x00,0x08,0x00,0x30,0xF8,0xFF,0x1F,0x08,0x00,0x10,0x08,
	0xC0,0x10,0x08,0x3F,0x10,0x08,0x00,0x10,0x08,0x00,0x10,0x08,0x00,0x13,0xC8,0xFF,
	0x10,0x08,0x22,0x10,0x08,0x22,0x10,0x08,0x22,0x10,0x08,0x22,0x10,0x08,0x21,0x12,
	0x08,0x21,0x14,0x88,0x60,0x16,0x48,0xC0,0x13,0x28,0x00,0x10,0x08,0x00,0x10,0xF8,
	0xFF,0x1F,0x08,0x00,0x10,0x00,0x00,0x00,/*"园",2*/
	"电",
	0x00,0x00,0x00,0x00,0x00,0x00,0x00,0x18,0x00,0x00,0x08,0x00,0x00,0x08,0x00,0x00,
	0x08,0x00,0xF0,0xFF,0x0F,0x10,0x08,0x04,0x10,0x08,0x04,0x10,0x08,0x04,0x10,0x08,
	0x04,0xF0,0xFF,0x07,0x10,0x08,0x04,0x10,0x08,0x04,0x10,0x08,0x04,0x10,0x08,0x04,
	0xF0,0xFF,0x07,0x10,0x08,0x00,0x00,0x08,0x10,0x00,0x08,0x10,0x00,0x08,0x20,0x00,
	0x18,0x30,0x00,0xF0,0x1F,0x00,0x00,0x00,/*"电",3*/
	"子",
	0x00,0x00,0x00,0x00,0x00,0x00,0x00,0x00,0x04,0xF0,0xFF,0x0F,0x00,0x00,0x06,0x00,
	0x00,0x01,0x00,0xC0,0x00,0x00,0x28,0x00,0x00,0x18,0x00,0x00,0x18,0x00,0x00,0x18,
	0x30,0xFE,0xFF,0x7F,0x00,0x18,0x00,0x00,0x18,0x00,0x00,0x18,0x00,0x00,0x18,0x00,
	0x00,0x18,0x00,0x00,0x18,0x00,0x00,0x18,0x00,0x00,0x18,0x00,0x00,0x18,0x00,0x00,
	0x1F,0x00,0x00,0x0C,0x00,0x00,0x00,0x00,/*"子",4*/
};

typedef struct 
{
	char Index[3];	
	char Msk[128];
}typFNT_GB32;

const typFNT_GB32 tfont32[]={
	"中",
	0x00,0x00,0x00,0x00,0x00,0x00,0x00,0x00,0x00,0x80,0x00,0x00,0x00,0x80,0x01,0x00,
	0x00,0x80,0x01,0x00,0x00,0x80,0x01,0x00,0x00,0x80,0x01,0x00,0x00,0x80,0x01,0x00,
	0x10,0x80,0x01,0x0C,0xF0,0xFF,0xFF,0x0F,0x30,0x80,0x01,0x04,0x30,0x80,0x01,0x04,
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	0x00,0x80,0x01,0x00,0x00,0x80,0x01,0x00,0x00,0x80,0x00,0x00,0x00,0x00,0x00,0x00,/*"中",0*/
	"景",
	0x00,0x00,0x00,0x00,0x00,0x00,0x00,0x00,0x00,0x00,0x00,0x00,0x00,0x01,0x80,0x01,
	0x00,0xFF,0xFF,0x01,0x00,0x03,0x80,0x01,0x00,0x03,0x80,0x01,0x00,0xFF,0xFF,0x01,
	0x00,0x03,0x80,0x01,0x00,0x03,0x80,0x01,0x00,0xFF,0xFF,0x01,0x00,0x81,0x81,0x00,
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	0x18,0x98,0x01,0x1C,0x04,0xE0,0x01,0x18,0x00,0xC0,0x00,0x00,0x00,0x00,0x00,0x00,/*"景",1*/
	"园",
	0x00,0x00,0x00,0x00,0x00,0x00,0x00,0x00,0x00,0x00,0x00,0x08,0xF0,0xFF,0xFF,0x1F,
	0x30,0x00,0x00,0x0C,0x30,0x00,0x00,0x0C,0x30,0x00,0x10,0x0C,0x30,0xFE,0x3F,0x0C,
	0x30,0x04,0x00,0x0C,0x30,0x00,0x00,0x0C,0x30,0x00,0x00,0x0C,0x30,0x00,0x00,0x0C,
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	0xF0,0xFF,0xFF,0x0F,0x30,0x00,0x00,0x0C,0x10,0x00,0x00,0x04,0x00,0x00,0x00,0x00,/*"园",2*/
	"电",
	0x00,0x00,0x00,0x00,0x00,0x00,0x00,0x00,0x00,0xC0,0x00,0x00,0x00,0xC0,0x01,0x00,
	0x00,0xC0,0x00,0x00,0x00,0xC0,0x00,0x00,0x00,0xC0,0x00,0x00,0x00,0xC0,0x00,0x00,
	0xE0,0xFF,0xFF,0x03,0x60,0xC0,0x00,0x03,0x60,0xC0,0x00,0x03,0x60,0xC0,0x00,0x03,
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	0x00,0xC0,0x01,0x38,0x00,0x80,0xFF,0x1F,0x00,0x00,0x00,0x00,0x00,0x00,0x00,0x00,/*"电",3*/
	"子",
	0x00,0x00,0x00,0x00,0x00,0x00,0x00,0x00,0x00,0x00,0x00,0x00,0x00,0x00,0x00,0x03,
	0xC0,0xFF,0xFF,0x07,0x00,0x00,0x80,0x07,0x00,0x00,0xC0,0x00,0x00,0x00,0x60,0x00,
	0x00,0x00,0x18,0x00,0x00,0x00,0x0C,0x00,0x00,0x80,0x03,0x00,0x00,0x80,0x03,0x00,
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	0x00,0xFC,0x01,0x00,0x00,0xE0,0x00,0x00,0x00,0x40,0x00,0x00,0x00,0x00,0x00,0x00,/*"子",4*/
};

void Display_GPIOConf(void)
{
	GPIO_InitTypeDef YuWei_GPIO_InitStructure = {0};
  __HAL_RCC_GPIOC_CLK_ENABLE();
	
  YuWei_GPIO_InitStructure.Pin = DISPLAY_SCK_PIN | DISPLAY_SDI_PIN | DISPLAY_DC_PIN | DISPLAY_RESET_PIN | DISPLAY_CS_PIN;
  YuWei_GPIO_InitStructure.Mode = GPIO_MODE_OUTPUT_PP;
  YuWei_GPIO_InitStructure.Speed = GPIO_SPEED_FREQ_HIGH;
  HAL_GPIO_Init(GPIOC, &YuWei_GPIO_InitStructure);
	HAL_GPIO_WritePin(GPIOC, DISPLAY_SCK_PIN | DISPLAY_SDI_PIN | DISPLAY_DC_PIN | DISPLAY_RESET_PIN | DISPLAY_CS_PIN, GPIO_PIN_SET);

	YuWei_GPIO_InitStructure.Pin = DISPLAY_SDO_PIN;
  YuWei_GPIO_InitStructure.Mode = GPIO_MODE_INPUT;
  YuWei_GPIO_InitStructure.Pull = GPIO_PULLUP;
  HAL_GPIO_Init(GPIOC, &YuWei_GPIO_InitStructure);
}

void Display_DelayNus(uint16_t us)
{
    uint16_t i;
    while(us--)
    {
        for(i = 0; i < 168; i++)  // 72可根据实际测试调整（确保延时1us）
        {
            __NOP(); // CPU空指令，需包含"core_cm3.h"（STM32默认包含）
        }
    }
}

/******************************************************************************
	函数说明：	LCD串行数据写入函数
	入口数据：	data要写入的串行数据
	返回值：  	无
******************************************************************************/
void SPI_Write1Byte(u8 byte) 
{
	DISPLAY_CS_L();  		// 拉低片选，选中LCD
	for(u8 i = 0; i < 8; i ++)
	{
		DISPLAY_SCK_L();  // SCK拉低，准备输出当前bit

		// 输出当前bit（高位优先）
		if(byte & 0x80)
		{
			DISPLAY_SDI_H();
		}
		else
		{
			DISPLAY_SDI_L();
		}

		DISPLAY_SCK_H();  // SCK拉高，LCD采样当前bit
		
		byte <<= 1;  			// 数据左移，准备下一个bit
	}
	DISPLAY_CS_H();  		// 拉高片选，结束写操作
}

/******************************************************************************
	函数说明：	LCD串行数据读取函数
	入口数据：	无
	返回值：  	读取到的1字节数据
******************************************************************************/
u8 SPI_Read1Byte(void)
{
	u8 tempByte = 0x00;  				// 存储读取到的字节数据

	DISPLAY_CS_L();  						// 拉低片选，选中SPI从设备（LCD）
	for(u8 i = 0; i < 8; i++)
	{
		DISPLAY_SCK_L();  				// SCK拉低，LCD准备当前位数据（与写函数时序一致）
		Display_DelayNus(1);  		// 延时等待数据稳定（根据硬件调整，1~5us均可）

		tempByte <<= 1;  					// 数据左移1位，腾出最低位存新读取的bit（高位优先）
		// 读取MISO引脚（SDI引脚，与写函数共用，此时需配置为输入）
		if(DISPLAY_SDO_V() == GPIO_PIN_SET)
		{
			tempByte |= 0x01;  			// 若引脚为高，当前bit置1
		}
		// 若引脚为低，tempByte最低位保持0，无需额外操作

		DISPLAY_SCK_H();  				// SCK拉高，完成当前位数据采样（与写函数时序一致）
		Display_DelayNus(1);  		// 延时稳定时序
	}
	DISPLAY_CS_H();  						// 拉高片选，结束SPI读操作
	return tempByte;  					// 返回读取到的1字节数据
}
/******************************************************************************
	函数说明：	LCD写入数据
	入口数据：	data写入的数据
	返回值：  	无
******************************************************************************/
void Display_Write1ByteData(u8 data)
{
	DISPLAY_DC_H();//写数据
	SPI_Write1Byte(data);
	DISPLAY_DC_L();
}
/******************************************************************************
	函数说明：	LCD写入数据
	入口数据：	data写入的数据
	返回值：  	无
******************************************************************************/
void Display_Write2BytesData(u16 data)
{
	DISPLAY_DC_H();//写数据
	SPI_Write1Byte((u8)(data>>8));
	SPI_Write1Byte((u8)data);
	DISPLAY_DC_L();
}
/******************************************************************************
	函数说明：	LCD写入命令
	入口数据：	data写入的命令
	返回值：  	无
******************************************************************************/
void Display_WriteCommand(u8 data)
{
	DISPLAY_DC_L();//写命令
	SPI_Write1Byte(data);
}
/******************************************************************************
	函数说明：	LCD读取ID（以读0xD3指令为例，具体指令需查屏幕手册）
	入口数据：	无
	返回值：  	LCDID
******************************************************************************/
u16 Display_GetID(void)
{
    u16 lcd_id = 0;

    // 1. 发送读ID指令（需用你的SPI_Write1Byte发送指令，注意指令格式）
    DISPLAY_CS_L();          					// 拉低片选
    SPI_Write1Byte(0xD3);    					// 发送读ID指令（不同屏幕指令可能不同）
    DISPLAY_CS_H();          					// 先拉高片选，结束指令发送

    // 2. 读取ID数据（多数LCD读ID需分两次操作，先读高8位，再读低8位）
    DISPLAY_CS_L();
    u8 temp = temp = SPI_Read1Byte();	// 部分屏幕首字节为无效数据，可丢弃
    lcd_id = SPI_Read1Byte() << 8;  	// 读取ID高8位
    lcd_id |= SPI_Read1Byte();      	// 读取ID低8位
    DISPLAY_CS_H();

    return lcd_id;
}
/******************************************************************************
	函数说明：	设置起始和结束地址
	入口数据：
				x1,x2设置列的起始和结束地址
				y1,y2设置行的起始和结束地址
	返回值：  	无
******************************************************************************/
void Display_SetAddress(u16 x1, u16 y1, u16 x2, u16 y2)
{
	Display_WriteCommand(0x2A);//列地址设置
	Display_Write2BytesData(x1);
	Display_Write2BytesData(x2);
	Display_WriteCommand(0x2B);//行地址设置
	Display_Write2BytesData(y1);
	Display_Write2BytesData(y2);
	Display_WriteCommand(0x2C);//储存器写
}

void Display_Reset(void)
{
	DISPLAY_RESET_L();
	HAL_Delay(5);
	DISPLAY_RESET_H();
	HAL_Delay(45);	
}

void Display_SeDirection(DISPLAY_DIRECTION displayDirection)
{
	Display_Direction = displayDirection % 12;

	if ((Display_Direction == Portrait_Upright) || (Display_Direction == Portrait_Upside_Down))
	{
		Display_Width = SHORT_SIDE;
		Display_Height = LONG_SIDE;
	}
	else if ((Display_Direction == Landscape_Rotated_Right) || (Display_Direction == Landscape_Rotated_Left))
	{
		Display_Width = LONG_SIDE;
		Display_Height = SHORT_SIDE;
	}
	else
	{
		Display_Width = 0;
		Display_Height = 0;
	}

	// 内存访问控制（0x36）：
	Display_WriteCommand(0x36);
	/*
		Bit7 MY:
					0 自上而下
					1 自下而上
		Bit6 MX:
					0 自左而右
					1 自右而左
		Bit5 MV:
					0 行列不交换
					1 行列交换
		Bit4 ML:
					0 自上而下刷新
					1 自下而上刷新
		Bit3 BGR/RGB:
					0 BGR
					1 RGB
		Bit2 MH:
					0 自左而右刷新
					1 自右而左刷新
					
	方向	屏幕方向状态	0x36		二进制			关键位解析（MY, MX, MV, BGR）
	0			竖屏机顶向上	0x80		1000 0000		MY=1, MX=0, MV=0（不交换）, 	BGR/RGB=1
	1			横屏机顶向右	0x20		1010 0000		MY=0, MX=0, MV=1（交换行列）, BGR/RGB=1
	2			竖屏机顶向下	0x40		0100 0000		MY=0, MX=1, MV=0（不交换）, 	BGR/RGB=1
	3			横屏机顶向左	0xE0		0110 0000		MY=1, MX=1, MV=1（交换行列）, BGR/RGB=1
	*/
	uint8_t mask = 0x08;
	switch(Display_Direction)
	{
		case Portrait_Upright:
		{
			Display_Write1ByteData(0x80 | mask);//↑ 100 0 1000 即0度显示
			break;
		}
		case Landscape_Rotated_Right:
		{
			Display_Write1ByteData(0x20 | mask);//→ 001 0 1000 即90度显示
			break;
		}
		case Portrait_Upside_Down:
		{
			Display_Write1ByteData(0x40 | mask);//↓ 010 0 1000 即180度显示
			break;
		}
		case Landscape_Rotated_Left:
		{
			Display_Write1ByteData(0xE0 | mask);//← 111 0 1000 即270度显示
			break;
		}
		default:
		{
			Display_Write1ByteData(0x40 | mask);//↑ 010 0 1000 即0度显示
			break;
		}
	}
	
	// 显示开启命令（0x29）：初始化完成，开启屏幕显示
	Display_WriteCommand(0x29);
	HAL_Delay(10);// 等待显示稳定
}

void Display_Init(DISPLAY_DIRECTION displayDirection)
{
	// 1. 初始化GPIO引脚（复用SPI引脚、Reset引脚、DC引脚等）
	Display_GPIOConf();

	// 2. 执行复位操作：拉低复位引脚→延迟→拉高→延迟，缩短冗余延时
	Display_Reset();

	// 3. 发送初始化命令序列（基于ILI9341标准时序，寄存器地址直接使用）
	// 软复位命令（0x01）：复位芯片内部状态，需后续等待稳定
	Display_WriteCommand(0x01);
	HAL_Delay(125);// 等待软复位完成，ILI9341要求至少120ms

	// 休眠模式退出命令（0x11）：唤醒芯片，准备进入工作状态
	Display_WriteCommand(0x11);
	HAL_Delay(125);// 等待芯片退出休眠，确保后续命令正常响应

	// 像素格式设置（0x3A）：配置为16位RGB565格式（0x55对应16bits/pixel）
	Display_WriteCommand(0x3A);
	Display_Write1ByteData(0x55);	

	// 显示亮度控制（0x51）：设置全屏亮度为最大（0xFF），可根据需求调整（0x00~0xFF）
	Display_WriteCommand(0x51);
	Display_Write1ByteData(0xFF);

	// 显示对比度控制（0x53）：设置对比度等级为中等（0x40），可根据需求调整（0x00~0xFF）
	Display_WriteCommand(0x53);
	Display_Write1ByteData(0x40);

	// 显示模式设置（0xB1）：配置正常显示模式（0x00=正常，0x01=部分显示，0x02=全黑）
	Display_WriteCommand(0xB1);
	Display_Write1ByteData(0x00);

	Display_SeDirection(displayDirection);
}
/******************************************************************************
      函数说明：在指定区域填充颜色
      入口数据：xsta,ysta   起始坐标
                xend,yend   终止坐标
								color       要填充的颜色
      返回值：  无
******************************************************************************/
void Display_Fill(u16 xsta, u16 ysta, u16 xend, u16 yend, u16 color)
{
	u32 total_pixel = (uint32_t)(xend - xsta) * (yend - ysta);
  u8 high_byte = color >> 8;
  u8 low_byte = color & 0xFF;

  Display_SetAddress(xsta, ysta, xend, yend);  	// 先设置显示区域
  DISPLAY_DC_H();  															// 切换为数据模式
  DISPLAY_CS_L();  															// 一次拉低CS，批量传输所有像素

  while(total_pixel--)  												// 连续传输，减少CS切换和函数调用开销
  {
    SPI_Write1Byte(high_byte);
    SPI_Write1Byte(low_byte);
  }

  DISPLAY_CS_H();  															// 传输完成再拉高CS
}
/******************************************************************************
      函数说明：在指定位置画点
      入口数据：x,y 画点坐标
                color 点的颜色
      返回值：  无
******************************************************************************/
void Display_DrawPoint(u16 x, u16 y, u16 color)
{
	Display_SetAddress(x, y, x, y);//设置光标位置 
	Display_Write2BytesData(color);
}
/******************************************************************************
      函数说明：画线
      入口数据：x1,y1   起始坐标
                x2,y2   终止坐标
                color   线的颜色
      返回值：  无
******************************************************************************/
void Display_DrawLine(u16 x1, u16 y1, u16 x2, u16 y2, u16 color)
{
	u16 t; 
	int xerr=0,yerr=0,delta_x,delta_y,distance;
	int incx,incy,uRow,uCol;
	delta_x=x2-x1; //计算坐标增量 
	delta_y=y2-y1;
	uRow=x1;//画线起点坐标
	uCol=y1;
	if(delta_x>0)incx=1; //设置单步方向 
	else if (delta_x==0)incx=0;//垂直线 
	else {incx=-1;delta_x=-delta_x;}
	if(delta_y>0)incy=1;
	else if (delta_y==0)incy=0;//水平线 
	else {incy=-1;delta_y=-delta_y;}
	if(delta_x>delta_y)distance=delta_x; //选取基本增量坐标轴 
	else distance=delta_y;
	for(t=0;t<distance+1;t++)
	{
		Display_DrawPoint(uRow,uCol,color);//画点
		xerr+=delta_x;
		yerr+=delta_y;
		if(xerr>distance)
		{
			xerr-=distance;
			uRow+=incx;
		}
		if(yerr>distance)
		{
			yerr-=distance;
			uCol+=incy;
		}
	}
}
/******************************************************************************
      函数说明：画矩形
      入口数据：x1,y1   起始坐标
                x2,y2   终止坐标
                color   矩形的颜色
      返回值：  无
******************************************************************************/
void Display_DrawRectangle(u16 x1, u16 y1, u16 x2, u16 y2,u16 color)
{
	Display_DrawLine(x1,y1,x2,y1,color);
	Display_DrawLine(x1,y1,x1,y2,color);
	Display_DrawLine(x1,y2,x2,y2,color);
	Display_DrawLine(x2,y1,x2,y2,color);
}
/******************************************************************************
      函数说明：画圆
      入口数据：x0,y0   圆心坐标
                r       半径
                color   圆的颜色
      返回值：  无
******************************************************************************/
void Display_DrawCircle(u16 x0, u16 y0, u8 r, u16 color)
{
	int a,b;
	a=0;b=r;	  
	while(a<=b)
	{
		Display_DrawPoint(x0-b,y0-a,color);             //3           
		Display_DrawPoint(x0+b,y0-a,color);             //0           
		Display_DrawPoint(x0-a,y0+b,color);             //1                
		Display_DrawPoint(x0-a,y0-b,color);             //2             
		Display_DrawPoint(x0+b,y0+a,color);             //4               
		Display_DrawPoint(x0+a,y0-b,color);             //5
		Display_DrawPoint(x0+a,y0+b,color);             //6 
		Display_DrawPoint(x0-b,y0+a,color);             //7
		a++;
		if((a*a+b*b)>(r*r))//判断要画的点是否过远
		{
			b--;
		}
	}
}

/******************************************************************************
      函数说明：显示汉字串
      入口数据：x,y显示坐标
                *s 要显示的汉字串
                fc 字的颜色
                bc 字的背景色
                sizey 字号 可选 16 24 32
                mode:  0非叠加模式  1叠加模式
      返回值：  无
******************************************************************************/
void Display_ShowChinese(u16 x, u16 y, char *s, u16 fc, u16 bc, u8 sizey, u8 mode)
{
	while(*s!=0)
	{
		if(sizey==12) 		Display_ShowChinese12x12(x,y,s,fc,bc,sizey,mode);
		else if(sizey==16) 	Display_ShowChinese16x16(x,y,s,fc,bc,sizey,mode);
		else if(sizey==24) 	Display_ShowChinese24x24(x,y,s,fc,bc,sizey,mode);
		else if(sizey==32) 	Display_ShowChinese32x32(x,y,s,fc,bc,sizey,mode);
		else return;
		s+=3;
		x+=sizey;
	}
}
/******************************************************************************
      函数说明：显示单个12x12汉字
      入口数据：x,y显示坐标
                *s 要显示的汉字
                fc 字的颜色
                bc 字的背景色
                sizey 字号
                mode:  0非叠加模式  1叠加模式
      返回值：  无
******************************************************************************/
void Display_ShowChinese12x12(u16 x, u16 y, char *s, u16 fc, u16 bc, u8 sizey, u8 mode)
{
	u8 i,j,m=0;
	u16 k;
	u16 HZnum;//汉字数目
	u16 TypefaceNum;//一个字符所占字节大小
	u16 x0=x;
	TypefaceNum=(sizey/8+((sizey%8)?1:0))*sizey;
	                         
	HZnum=sizeof(tfont12)/sizeof(typFNT_GB12);	//统计汉字数目
	for(k=0;k<HZnum;k++) 
	{
		if((tfont12[k].Index[0]==*(s))&&(tfont12[k].Index[1]==*(s+1))&&(tfont12[k].Index[2]==*(s+2)))
		{ 	
			Display_SetAddress(x,y,x+sizey-1,y+sizey-1);
			for(i=0;i<TypefaceNum;i++)
			{
				for(j=0;j<8;j++)
				{	
					if(!mode)//非叠加方式
					{
						if(tfont12[k].Msk[i]&(0x01<<j))Display_Write2BytesData(fc);
						else Display_Write2BytesData(bc);
						m++;
						if(m%sizey==0)
						{
							m=0;
							break;
						}
					}
					else//叠加方式
					{
						if(tfont12[k].Msk[i]&(0x01<<j))	Display_DrawPoint(x,y,fc);//画一个点
						x++;
						if((x-x0)==sizey)
						{
							x=x0;
							y++;
							break;
						}
					}
				}
			}
		}				  	
		continue;  //查找到对应点阵字库立即退出，防止多个汉字重复取模带来影响
	}
}
/******************************************************************************
      函数说明：显示单个16x16汉字
      入口数据：x,y显示坐标
                *s 要显示的汉字
                fc 字的颜色
                bc 字的背景色
                sizey 字号
                mode:  0非叠加模式  1叠加模式
      返回值：  无
******************************************************************************/
void Display_ShowChinese16x16(u16 x, u16 y, char *s, u16 fc, u16 bc, u8 sizey, u8 mode)
{
	u8 i,j,m=0;
	u16 k;
	u16 HZnum;//汉字数目
	u16 TypefaceNum;//一个字符所占字节大小
	u16 x0=x;
  TypefaceNum=(sizey/8+((sizey%8)?1:0))*sizey;
	HZnum=sizeof(tfont16)/sizeof(typFNT_GB16);	//统计汉字数目
	for(k=0;k<HZnum;k++) 
	{
		if ((tfont16[k].Index[0]==*(s))&&(tfont16[k].Index[1]==*(s+1))&&(tfont16[k].Index[2]==*(s+2)))
		{ 	
			Display_SetAddress(x,y,x+sizey-1,y+sizey-1);
			for(i=0;i<TypefaceNum;i++)
			{
				for(j=0;j<8;j++)
				{	
					if(!mode)//非叠加方式
					{
						if(tfont16[k].Msk[i]&(0x01<<j))Display_Write2BytesData(fc);
						else Display_Write2BytesData(bc);
						m++;
						if(m%sizey==0)
						{
							m=0;
							break;
						}
					}
					else//叠加方式
					{
						if(tfont16[k].Msk[i]&(0x01<<j))	Display_DrawPoint(x,y,fc);//画一个点
						x++;
						if((x-x0)==sizey)
						{
							x=x0;
							y++;
							break;
						}
					}
				}
			}
		}				  	
		continue;  //查找到对应点阵字库立即退出，防止多个汉字重复取模带来影响
	}
}
/******************************************************************************
      函数说明：显示单个24x24汉字
      入口数据：x,y显示坐标
                *s 要显示的汉字
                fc 字的颜色
                bc 字的背景色
                sizey 字号
                mode:  0非叠加模式  1叠加模式
      返回值：  无
******************************************************************************/
void Display_ShowChinese24x24(u16 x, u16 y, char *s, u16 fc, u16 bc, u8 sizey, u8 mode)
{
	u8 i,j,m=0;
	u16 k;
	u16 HZnum;//汉字数目
	u16 TypefaceNum;//一个字符所占字节大小
	u16 x0=x;
	TypefaceNum=(sizey/8+((sizey%8)?1:0))*sizey;
	HZnum=sizeof(tfont24)/sizeof(typFNT_GB24);	//统计汉字数目
	for(k=0;k<HZnum;k++) 
	{
		if ((tfont24[k].Index[0]==*(s))&&(tfont24[k].Index[1]==*(s+1))&&(tfont24[k].Index[2]==*(s+2)))
		{ 	
			Display_SetAddress(x,y,x+sizey-1,y+sizey-1);
			for(i=0;i<TypefaceNum;i++)
			{
				for(j=0;j<8;j++)
				{	
					if(!mode)//非叠加方式
					{
						if(tfont24[k].Msk[i]&(0x01<<j))Display_Write2BytesData(fc);
						else Display_Write2BytesData(bc);
						m++;
						if(m%sizey==0)
						{
							m=0;
							break;
						}
					}
					else//叠加方式
					{
						if(tfont24[k].Msk[i]&(0x01<<j))	Display_DrawPoint(x,y,fc);//画一个点
						x++;
						if((x-x0)==sizey)
						{
							x=x0;
							y++;
							break;
						}
					}
				}
			}
		}				  	
		continue;  //查找到对应点阵字库立即退出，防止多个汉字重复取模带来影响
	}
}
/******************************************************************************
      函数说明：显示单个32x32汉字
      入口数据：x,y显示坐标
                *s 要显示的汉字
                fc 字的颜色
                bc 字的背景色
                sizey 字号
                mode:  0非叠加模式  1叠加模式
      返回值：  无
******************************************************************************/
void Display_ShowChinese32x32(u16 x, u16 y, char *s, u16 fc, u16 bc, u8 sizey, u8 mode)
{
	u8 i,j,m=0;
	u16 k;
	u16 HZnum;//汉字数目
	u16 TypefaceNum;//一个字符所占字节大小
	u16 x0=x;
	TypefaceNum=(sizey/8+((sizey%8)?1:0))*sizey;
	HZnum=sizeof(tfont32)/sizeof(typFNT_GB32);	//统计汉字数目
	for(k=0;k<HZnum;k++) 
	{
		if ((tfont32[k].Index[0]==*(s))&&(tfont32[k].Index[1]==*(s+1))&&(tfont32[k].Index[2]==*(s+2)))
		{ 	
			Display_SetAddress(x,y,x+sizey-1,y+sizey-1);
			for(i=0;i<TypefaceNum;i++)
			{
				for(j=0;j<8;j++)
				{	
					if(!mode)//非叠加方式
					{
						if(tfont32[k].Msk[i]&(0x01<<j))Display_Write2BytesData(fc);
						else Display_Write2BytesData(bc);
						m++;
						if(m%sizey==0)
						{
							m=0;
							break;
						}
					}
					else//叠加方式
					{
						if(tfont32[k].Msk[i]&(0x01<<j))	Display_DrawPoint(x,y,fc);//画一个点
						x++;
						if((x-x0)==sizey)
						{
							x=x0;
							y++;
							break;
						}
					}
				}
			}
		}				  	
		continue;  //查找到对应点阵字库立即退出，防止多个汉字重复取模带来影响
	}
}
/******************************************************************************
      函数说明：显示单个字符
      入口数据：x,y显示坐标
                num 要显示的字符
                fc 字的颜色
                bc 字的背景色
                sizey 字号
                mode:  0非叠加模式  1叠加模式
      返回值：  无
******************************************************************************/
void Display_ShowCharacter(u16 x, u16 y, u8 num, u16 fc, u16 bc, u8 sizey, u8 mode)
{
	u8 temp,sizex,t,m=0;
	u16 i,TypefaceNum;//一个字符所占字节大小
	u16 x0=x;
	sizex=sizey/2;
	TypefaceNum=(sizex/8+((sizex%8)?1:0))*sizey;
	num=num-' ';    //得到偏移后的值
	Display_SetAddress(x,y,x+sizex-1,y+sizey-1);  //设置光标位置 
	for(i=0;i<TypefaceNum;i++)
	{ 
		if(sizey==12)temp=ascii_1206[num][i];		       //调用6x12字体
		else if(sizey==16)temp=ascii_1608[num][i];		 //调用8x16字体
		else if(sizey==24)temp=ascii_2412[num][i];		 //调用12x24字体
		else if(sizey==32)temp=ascii_3216[num][i];		 //调用16x32字体
		else return;
		for(t=0;t<8;t++)
		{
			if(!mode)//非叠加模式
			{
				if(temp&(0x01<<t))Display_Write2BytesData(fc);
				else Display_Write2BytesData(bc);
				m++;
				if(m%sizex==0)
				{
					m=0;
					break;
				}
			}
			else//叠加模式
			{
				if(temp&(0x01<<t))Display_DrawPoint(x,y,fc);//画一个点
				x++;
				if((x-x0)==sizex)
				{
					x=x0;
					y++;
					break;
				}
			}
		}
	}   	 	  
}
/******************************************************************************
      函数说明：显示字符串
      入口数据：x,y显示坐标
                *p 要显示的字符串
                fc 字的颜色
                bc 字的背景色
                sizey 字号
                mode:  0非叠加模式  1叠加模式
      返回值：  无
******************************************************************************/
void Display_ShowString(u16 x, u16 y, const char *p, u16 fc, u16 bc, u8 sizey, u8 mode)
{         
	while(*p!='\0')
	{       
		Display_ShowCharacter(x,y,*p,fc,bc,sizey,mode);
		x+=sizey/2;
		p++;
	}  
}
/******************************************************************************
      函数说明：显示数字
      入口数据：m底数，n指数
      返回值：  无
******************************************************************************/
u32 Display_Pow(u8 m,u8 n)
{
	u32 result=1;	 
	while(n--)result*=m;
	return result;
}
/******************************************************************************
      函数说明：显示整数变量
      入口数据：x,y显示坐标
                num 要显示整数变量
                len 要显示的位数
                fc 字的颜色
                bc 字的背景色
                sizey 字号
      返回值：  无
******************************************************************************/
void Display_ShowInteger(u16 x, u16 y, u16 num, u8 len, u16 fc, u16 bc, u8 sizey)
{         	
	u8 t,temp;
	u8 enshow=0;
	u8 sizex=sizey/2;
	for(t=0;t<len;t++)
	{
		temp=(num/Display_Pow(10,len-t-1))%10;
		if(enshow==0&&t<(len-1))
		{
			if(temp==0)
			{
				Display_ShowCharacter(x+t*sizex,y,' ',fc,bc,sizey,0);
				continue;
			}else enshow=1; 
		 	 
		}
	 	Display_ShowCharacter(x+t*sizex,y,temp+48,fc,bc,sizey,0);
	}
}
/******************************************************************************
      函数说明：显示两位小数变量
      入口数据：x,y显示坐标
                num 要显示小数变量
                len 要显示的位数
                fc 字的颜色
                bc 字的背景色
                sizey 字号
      返回值：  无
******************************************************************************/
void Display_ShowFloat(u16 x, u16 y, float num, u8 len, u16 fc, u16 bc, u8 sizey)
{         	
	u8 t,temp,sizex;
	u16 num1;
	sizex=sizey/2;
	num1=num*100;
	for(t=0;t<len;t++)
	{
		temp=(num1/Display_Pow(10,len-t-1))%10;
		if(t==(len-2))
		{
			Display_ShowCharacter(x+(len-2)*sizex,y,'.',fc,bc,sizey,0);
			t++;
			len+=1;
		}
	 	Display_ShowCharacter(x+t*sizex,y,temp+48,fc,bc,sizey,0);
	}
}
/******************************************************************************
      函数说明：显示图片
      入口数据：x,y起点坐标
                length 图片长度
                width  图片宽度
                pic[]  图片数组    
      返回值：  无
******************************************************************************/
void Display_ShowPicture(u16 x, u16 y, u16 height, u16 width, const u8 pic[])
{
	u16 i,j;
	u32 k=0;
	Display_SetAddress(x,y,x+height-1,y+width-1);
	for(i=0;i<height;i++)
	{
		for(j=0;j<width;j++)
		{
			Display_Write1ByteData(pic[k*2]);
			Display_Write1ByteData(pic[k*2+1]);
			k++;
		}
	}
}
